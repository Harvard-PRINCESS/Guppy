#include <offsets.h>

OUTPUT_FORMAT("elf32-littlearm")
OUTPUT_ARCH("arm")

ENTRY(start)

PHDRS
{
    load PT_LOAD;
}

SECTIONS {

    . = ALIGN(4k);
    boot_start = .;
    kernel_first_byte = .;
    kernel_init_start = .;

    /* The page tables need a larger alignment. */
    . = ALIGN(16k);
    .boot . :
    {
        *(.boot.tables);
        *(.boot);
    } :load

    boot_text_start = .;

    .text : {
        *(.text);
        *(.text.unlikely);
    }

    .rodata . :
    {
        *(.rodata);
        *(.rodata.*);
    }

    build_id_nhdr = .;
    .note.gnu.build-id . :
    {
        *(.note.gnu.build-id);
    }

    boot_text_end = .;

    kernel_text_final_byte = .;

    /* Everything up until this point (except the BSP code) is shared among
     * all kernel instances, but everything from here on will need to be
     * separately allocated and relocated, and must thus sit in a different
     * frame. */

    . = ALIGN(4k);

    .got . :
    {
        got_base = .;
        *(.got);
        *(.got.plt);
    }

    .data . :
    {
        *(.data);
        *(.data.*);
    }

    .bss . :
    {
        *(.bss);
    }

    .rel.dyn . :
    {
        *(.rel.dyn);
    }

    boot_end = .;
    kernel_final_byte = .;


    /***** These sections get discarded *****/
    /DISCARD/ :
    {
        /* Discard exception handler frames and headers -- we don't use em */
        *(.eh_frame);
        *(.eh_frame_hdr);
        *(.interp);
        /**(.dynamic); */
    }
}
